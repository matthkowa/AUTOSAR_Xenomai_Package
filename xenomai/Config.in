## xenomai/Config.in
```kconfig
comment "xenomai needs a toolchain w/ threads"
	depends on !BR2_TOOLCHAIN_HAS_THREADS
	depends on BR2_i386 || BR2_x86_64 || BR2_arm || \
		   BR2_bfin || BR2_powerpc || BR2_sh4

config BR2_PACKAGE_XENOMAI
	bool "Xenomai Userspace"
	depends on BR2_TOOLCHAIN_HAS_THREADS
	depends on BR2_i386 || BR2_x86_64 || BR2_arm || \
		BR2_bfin || BR2_powerpc || BR2_sh4
	help
	  Real-Time Framework for Linux
	  http://www.xenomai.org

	  Xenomai is split in two parts: a kernel part and an
	  userspace part.

	  This package contains the userspace part, which consists
	  mainly in libraries to write userspace real-time programs
	  that interact with the in-kernel Xenomai real-time core.

	  For those libraries to work, you need a Xenomai-enabled
	  kernel. This is possible in two ways:
	   - if you compile your kernel with Buildroot, you need to go
	     to Linux Kernel -> Linux Kernel Extensions to enable the
	     Xenomai extension.
	   - if you compile your kernel outside of Buildroot, you need
	     to make sure that it is Xenomai-enabled.

	  Finally, if you are using a static /dev, make sure to
	  uncomment the Xenomai entries listed in
	  target/generic/device_table_dev.txt.

if BR2_PACKAGE_XENOMAI

choice
	prompt "Xenomai Core type"
	default BR2_PACKAGE_XENOMAI_COBALT
	help 
	  Selects the type of core 

config BR2_PACKAGE_XENOMAI_COBALT
	bool "Cobalt Core"
	help	
	  Select the dual-kernel mode

config BR2_PACKAGE_XENOMAI_MERCURY
	bool "Mercury Core"
	help	
	  Select the mono-kernel mode
comment "Mercury need PREEMPT_RT to run"
	depends on BR2_PACKAGE_XENOMAI_MERCURY

endchoice

config BR2_PACKAGE_XENOMAI_TESTSUITE
	bool "Install testsuite"
	help
	  This option allows to install the Xenomai test programs.

config BR2_PACKAGE_XENOMAI_RTCAN
	bool "RTCan utilities"
	help
	  This option allows to install the Xenomai RT-CAN utilities.

config BR2_PACKAGE_XENOMAI_ANALOGY
	bool "Analogy libs and utils"
	help
	  This option allows to install the Xenomai Analogy utilities
	  and libraries

config BR2_PACKAGE_XENOMAI_ALCHEMY_SKIN
	bool "Alchemy skin library"
	default y
	help
	  This option allows to install the Native Xenomai skin named Alchemy

config BR2_PACKAGE_XENOMAI_AUTOSAR_SKIN
	bool "AUTOSAR skin library"
	default y
        select BR2_PACKAGE_XENOMAI_RTDM_SKIN
	help
	  This option allows to install the AUTOSAR Xenomai skin

if BR2_PACKAGE_XENOMAI_AUTOSAR_SKIN

choice
	prompt "AUTOSAR application"
	default BR2_PACKAGE_XENOMAI_COBALT
	help 
	  Selects an application to run 

config BR2_PACKAGE_XENOMAI_AUTOSAR_SKIN_TASK_1
	bool "Task 1"
	help	
	   Select Task test 1

config BR2_PACKAGE_XENOMAI_AUTOSAR_SKIN_TASK_2
	bool "Task 2"
	help	
	  Select Task test 2

config BR2_PACKAGE_XENOMAI_AUTOSAR_SKIN_ALARM_1
	bool "Alarm 1"
	help	
	  Select Alarm test 1

config BR2_PACKAGE_XENOMAI_AUTOSAR_SKIN_ALARM_2
	bool "Alarm 2"
	help	
	  Select Alarm test 2

config BR2_PACKAGE_XENOMAI_AUTOSAR_SKIN_ALARM_3
	bool "Alarm 3"
	help	
	  Select Alarm test 3

config BR2_PACKAGE_XENOMAI_AUTOSAR_SKIN_ALARM_4
	bool "Alarm 4"
	help	
	  Select Alarm test 4

config BR2_PACKAGE_XENOMAI_AUTOSAR_SKIN_HOOK_1
	bool "Hook 1"
	help	
	  Select Hook test 1

config BR2_PACKAGE_XENOMAI_AUTOSAR_SKIN_RESOURCE_1
	bool "Resource 1"
	help	
	  Select Resource test 1

config BR2_PACKAGE_XENOMAI_AUTOSAR_SKIN_CUSTOM
	bool "Custom"
	help	
	  Select custom application


endchoice

if BR2_PACKAGE_XENOMAI_AUTOSAR_SKIN_CUSTOM

config BR2_PACKAGE_XENOMAI_AUTOSAR_MODEL_FILE
	string "AUTOSAR Model file"
	help
	  This file is the AUTOSAR Model file (.arxml)

config BR2_PACKAGE_XENOMAI_AUTOSAR_C_DIRECTORY
	string "AUTOSAR C file"
	help
	  This directory contains all  AUTOSAR C files of the application and ONLY the AUTOSAR  files of the application

endif

config BR2_PACKAGE_XENOMAI_AUTOSAR_SKIN_AUTORUN
	bool "Run the application after linux boot"
	help	
	   Check if you want to run the AUTOSAR application after the Linux Kernel Boot


endif
config BR2_PACKAGE_XENOMAI_POSIX_SKIN
	bool "POSIX skin library"
	default y
	help
	  This option allows to install the POSIX Xenomai skin

config BR2_PACKAGE_XENOMAI_VXWORKS_SKIN
	bool "VX-Works skin library"
	help
	  This option allows to install the VX-Works Xenomai skin

config BR2_PACKAGE_XENOMAI_PSOS_SKIN
	bool "PSOS skin library"
	help
	  This option allows to install the PSOS Xenomai skin

config BR2_PACKAGE_XENOMAI_RTDM_SKIN
	bool "RTDM skin library"
	help
	  This option allows to install the RTDM Xenomai skin

config BR2_PACKAGE_XENOMAI_SMOKEY_SKIN
	bool "Smokey skin library"
	help
	  This option allows to install the smokey Xenomai skin

endif
```
